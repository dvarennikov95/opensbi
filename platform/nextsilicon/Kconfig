## platform/nextsilicon/Kconfig
```kconfig
# SPDX-License-Identifier: BSD-2-Clause

#
# All mandatory drivers or libraries for this platform should
# be directly selected by the PLATFORM_xyz kconfig symbol.
#
# All optional drivers or libraries for this platform should
# be enabled via configs/defconfig of this platform.
#
config PLATFORM_NEXTSILICON_SCR7
	bool
	select SERIAL_UART8250
	select IRQCHIP_PLIC
	select TIMER_MTIMER
	default y
```

## platform/pcore/Kconfig
```kconfig
config PLATFORM_NEXTSILICON_PCORE_SCR7_GEN1
	bool
	select TIMER_MTIMER
	select SERIAL_UART8250
	default y
```
